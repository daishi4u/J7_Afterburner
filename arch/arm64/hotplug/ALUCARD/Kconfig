## arch/arm64/hotplug/ALUCARD/Kconfig
```kconfig
config ALUCARD_HOTPLUG
	bool "Enable alucard-hotplug cpu hotplug driver"
	default n
	help
	  Generic Alucard-hotplug cpu hotplug driver for ARM SOCs
```

## arch/arm64/hotplug/BRICKED/Kconfig
```kconfig
config BRICKED_HOTPLUG
	bool "Enable kernel based mpdecision"
	default n
	help
	 This enables kernel based multi core control.
	 (up/down hotplug based on load)
```

## arch/arm64/hotplug/HIMA/Kconfig
```kconfig
config HIMA_HOTPLUG
        bool "Enable hima-hotplug cpu hotplug driver"
        default n
        help
          Generic cpu hotplugging driver for ARM SOCs
```

## arch/arm64/hotplug/INTELLIPLUG/Kconfig
```kconfig
config INTELLI_PLUG
	   bool "intelliplug hotplug"
	   default y
	   help
		 This enables kernel based multi core control.
```

## arch/arm64/hotplug/MAKO/Kconfig
```kconfig
config MAKO_HOTPLUG
    bool "Mako Hotplug"
    default y
    help
      Mako Hotplug: A custom hotplug by fransico franco
```
